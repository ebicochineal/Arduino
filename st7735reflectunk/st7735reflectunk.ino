#include <Adafruit_GFX.h>
#include <Adafruit_ST7735.h>
#include <SPI.h>

// uno       G   V   8   9  10  11  13
// ST7735    G   V  DC RES  CS SDA SCL

#define TFT_CS        10
#define TFT_RST        9
#define TFT_DC         8
#define TFT_BACKLIGHT  7

Adafruit_ST7735 tft = Adafruit_ST7735(TFT_CS, TFT_DC, TFT_RST);
//Adafruit_ST7735 tft = Adafruit_ST7735(TFT_CS, TFT_DC, TFT_MOSI, TFT_SCLK, TFT_RST);

int8_t unk[] = {9,9,9,9,9,9,9,9,9,9,9,9,9,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9,9};

void setup(void) {
    tft.initR(INITR_MINI160x80);
    pinMode(TFT_BACKLIGHT, OUTPUT);
    digitalWrite(TFT_BACKLIGHT, HIGH);
    
    
    tft.invertDisplay(true);
    tft.fillScreen(ST77XX_BLACK);
    delay(100);
    
    // display noise clear
    tft.setRotation(0);
    tft.fillScreen(ST77XX_BLACK);
    tft.setRotation(1);
    tft.fillScreen(ST77XX_BLACK);
    tft.setRotation(2);
    tft.fillScreen(ST77XX_BLACK);
    tft.setRotation(3);
    tft.fillScreen(ST77XX_BLACK);
    tft.setRotation(0);
    tft.fillScreen(ST77XX_BLACK);
}
uint16_t Color565 (uint8_t r, uint8_t g, uint8_t b) {
    return ((b & 0xF8) << 8) | ((g & 0xFC) << 3) | (r >> 3);
}
inline uint32_t xrnd() {
    static uint32_t y = 2463534242;
    y = y ^ (y << 13);
    y = y ^ (y >> 17);
    return y = y ^ (y << 5);
}

int px = 40-16;
int py = 80-16;
int rx = 2;
int ry = 2;
int ncnt = 0;
void loop() {
    
    px += rx;
    py += ry;
    
    if (px >= 80-32) { rx = -2; ncnt = 4; }
    if (py >= 160-32) { ry = -2; ncnt = 4; }
    if (px <= 0) { rx = 2; ncnt = 4; }
    if (py <= 0) { ry = 2; ncnt = 4; }
    
    for (int x = -2; x < 34; ++x) {
        for (int y = -2; y < 34; ++y) {
            int mx = px + x;
            int my = py + y;
            if (x < 0 || x >= 32 || y < 0 || y >= 32) {
                tft.drawPixel(mx, my, Color565(0, 0, 0));
                continue;
            }
            
            int tp = y * 32 + x;
            
            if (ncnt > 0) {
                int8_t t = unk[tp] >> 3;
                if (t == 2) {
                    tft.drawPixel(mx, my, Color565(64, 32, 0));
                } else if (t == 3) {
                    tft.drawPixel(mx, my, Color565(32, 110, 127));
                } else if (t == 4) {
                    tft.drawPixel(mx, my, Color565(127, 127, 127));
                } else {
                    tft.drawPixel(mx, my, Color565(0, 0, 0));
                }
            } else {
                int8_t t = unk[tp] & 0b111;
                if (t == 2) {
                    tft.drawPixel(mx, my, Color565(64, 32, 0));
                } else if (t == 3) {
                    tft.drawPixel(mx, my, Color565(127, 0, 0));
                } else if (t == 4) {
                    tft.drawPixel(mx, my, Color565(127, 127, 127));
                } else {
                    tft.drawPixel(mx, my, Color565(0, 0, 0));
                }
            }
        }
    }
    if (ncnt > 0) { ncnt -= 1; }
}



